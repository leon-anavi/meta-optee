## conf/machine/qemuarm-virt.conf
```bitbake
#@TYPE: Machine
#@NAME: qemuarm-virt

#@DESCRIPTION: Machine configuration for qemuarm-virt systems

PREFERRED_PROVIDER_virtual/kernel ?= "linux-optee"

DEFAULTTUNE ?= "cortexa15hf"

IMAGE_FSTYPES ?= "cpio.gz"

require conf/machine/include/qemu.inc
require conf/machine/include/tune-cortexa15.inc

KERNEL_IMAGETYPE = "zImage"
SERIAL_CONSOLE = "115200 ttyAMA0"
```
